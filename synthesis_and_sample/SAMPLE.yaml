## synthesis_and_sample/base_classes/sample.yaml
```yaml
sample:
  ID:
  name:
  user:
  citation: doi
  method: [experimental, simulation, declared by vendor]
  chemical_specimen or material: [mixture, composite, gel, ...]
    exists: [min, 1, max, unbounded]
    chemical_substance:
      exists: [min, 1, max, unbounded]
      INCHI: ...
      name: IUPAC
      molecular mass: in g/mol
      concentration: if needed
      amount: added amount
      electron distribution: for simulations
      number_of_electrons:
      ...
    geometry: shape description, orientation if it matters
    physical state: solid, crystalline, ...
    amount: present in the sample
    role in experiment: carrier, catalyst, substrate, layer
    bath: where it was taking from
  property_1: characterization needed for this sample as reference
  property_2:
  ...
  other properties: "..."
  
```
